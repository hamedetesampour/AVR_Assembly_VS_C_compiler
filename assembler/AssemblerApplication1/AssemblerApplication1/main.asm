;
; 7 seg blink.asm
;
; Created: 1/5/2022 5:44:19 PM
; Author : Hamed Etsm
;


; Replace with your application code

.INCLUDE "M32DEF.INC"
;;;;;;;;;;;;;;;;;;;;;;;;;;
LDI		R16,LOW(RAMEND)
OUT		SPL,R16
LDI		R16,HIGH(RAMEND)
OUT		SPH,R16
;;;;;;;;;;;;;;;;;;;;;;;;;;
LDI		R17,255
OUT		DDRA,R17
loop:
	SBI PORTA,2 ;a=2 b=3 c=6 d=5 e=4 f=1 g=0
	RCALL DELAY
	CBI PORTA,2
	RCALL DELAY
	SBI PORTA,3
	RCALL DELAY
	CBI PORTA,3
	RCALL DELAY
	SBI PORTA,6
	RCALL DELAY
	CBI PORTA,6
	RCALL DELAY
	SBI PORTA,5
	RCALL DELAY
	CBI PORTA,5
	RCALL DELAY
	SBI PORTA,4
	RCALL DELAY
	CBI PORTA,4
	RCALL DELAY
	SBI PORTA,1
	RCALL DELAY
	CBI PORTA,1
	RCALL DELAY
	SBI PORTA,0
	RCALL DELAY
	CBI PORTA,0
	RCALL DELAY
	OUT PORTA,R17
	RCALL DELAY
	LDI R22,0
	OUT PORTA,R22
	RCALL DELAY
JMP LOOP 
;;;;;;;;;;;;;;;;;;;;;;;;;;;
DELAY: 
	LDI R18,255				;1 
	LOOP1: 
		LDI R19,255			;1*255
			LOOP2:
			LDI R20,5		;1*255*255
				LOOP3:
				DEC	 R20	;1*255*255*5
				BRNE LOOP3	;2*255*255*5-255*255
			DEC	 R19		;1*255*255
			BRNE LOOP2		;2*255*255-255
		DEC R18				;1*255
		BRNE LOOP1			;2*255-1
RET
